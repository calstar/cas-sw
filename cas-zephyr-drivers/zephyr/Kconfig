## cas-zephyr-drivers/zephyr/Kconfig
```kconfig
# Copyright (c) 2021 Aled Cuda <aled@berkeley.edu>
# SPDX-License-Identifier: BSD-3-Clause

menu "CAS"

rsource "drivers/Kconfig"

endmenu
```

## cas-zephyr-drivers/zephyr/boards/arm/cas_core_f446rc/Kconfig.board
```kconfig
config BOARD_CAS_CORE_F446RC
	bool "STAR CAS Core F446CE edition"
	depends on SOC_STM32F446XX
```

## cas-zephyr-drivers/zephyr/boards/arm/cas_core_f446rc/Kconfig.defconfig
```kconfig
if BOARD_CAS_CORE_F446RC

config BOARD
	default "cas_core_f446rc"

config SPI_STM32_INTERRUPT
	default y
	depends on SPI

endif # BOARD_CAS_CORE_F446CE
```

## cas-zephyr-drivers/zephyr/drivers/BNO055_driver/Kconfig
```kconfig
# Copyright (c) 2020 Facebook, Inc. and its affiliates
# SPDX-License-Identifier: Apache-2.0

menuconfig BNO055_driver
        bool "bno055 driver"
        default y
        help
          Enable support for bno055 driver

if BNO055_driver

module = BNO055_driver
module-str = bno055_driver
source "subsys/logging/Kconfig.template.log_config"

endif
```

## cas-zephyr-drivers/zephyr/drivers/Kconfig
```kconfig
# Copyright (c) 2021 Aled Cuda <aled@berkeley.edu>
# SPDX-License-Identifier: BSD-3-Clause

menu "CAS"

# Add more drivers here like https://github.com/olofk/serv/tree/main/zephyr/drivers
#rsource "drivername/Kconfig"

endmenu
```
