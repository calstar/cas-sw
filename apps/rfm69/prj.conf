## CMakeLists.txt
```
# SPDX-License-Identifier: Apache-2.0

cmake_minimum_required(VERSION 3.20.0)

list(APPEND BOARD_ROOT ${CMAKE_CURRENT_SOURCE_DIR}/../../cas-zephyr-drivers/zephyr)
list(APPEND SOC_ROOT ${CMAKE_CURRENT_SOURCE_DIR}/../../cas-zephyr-drivers/zephyr)
list(APPEND DTS_ROOT ${CMAKE_CURRENT_SOURCE_DIR}/../../cas-zephyr-drivers/zephyr)

# To add out-of-tree device drivers to the project, uncomment the following line.
# list(APPEND ZEPHYR_EXTRA_MODULES ${CMAKE_CURRENT_SOURCE_DIR}/../../cas-zephyr-drivers/zephyr/drivers/my_driver)

find_package(Zephyr REQUIRED HINTS $ENV{ZEPHYR_BASE})

# Update the following line to contain the name of the current application.
project(rfm69)

# If you have multiple source files, list all of them here.
target_sources(app PRIVATE src/main.c src/rfm69.c src/cas_spi.c src/rfm69.h src/cas_spi.h src/RFM69registers.h)
```

## prj.conf
```kconfig
<<<<<<< HEAD:apps/rfm69/prj.conf
CONFIG_SPI=y
CONFIG_SPI_STM32=y
CONFIG_GPIO=y
=======
CONFIG_I2C=y
>>>>>>> cooper-gps-bodge:apps/GPS/prj.conf
```

## cas_spi0.overlay
```dts
&spi2 {
	status = "okay";
	cs-gpios = <&gpiob 9 GPIO_ACTIVE_LOW>;
	label = "SPI2";
};
```

## src/main.c
```c
#include <zephyr.h>
#include <device.h>
#include <devicetree.h>
#include "rfm69.h"
#include "cas_spi.h"

#define NETWORKID 0
#define MYNODEID 0
#define TONODEID 255

#define DEVICE_NODE cas_spi0

uint8_t payload_buffer[PAYLOAD_LENGTH];

void clear_payload_buffer() {
	for (int i=0; i<sizeof(payload_buffer); i++) {
		payload_buffer[i] = 0;
	}
}

void main(void) {

	printk("--- RFM69 Radio Transciever ---\n");

	// This application uses SPI bus 2, aka cas_spi0
	const struct device *spi_dev = DEVICE_DT_GET(DT_NODELABEL(DEVICE_NODE));

	// This application uses pin B9 as the CS pin
	const struct spi_cs_control ctrl = {
    	.gpio_dev = DEVICE_DT_GET(DT_NODELABEL(gpiob)),
    	.gpio_pin = 9,
    	.gpio_dt_flags = GPIO_ACTIVE_LOW,
    };

	const struct spi_config cfg = {
		.frequency = 1000000,
		.operation = SPI_OP_MODE_MASTER | SPI_TRANSFER_MSB | SPI_WORD_SET(8),
		.cs = &ctrl,
	};

	if (spi_dev == NULL) {
		printk("Error in main.c: Failed to get device binding.\n");
		return NULL;
	}
	if (!device_is_ready(spi_dev)) {
		printk("Error in main.c: Device is not ready.\n");
		return NULL;
	}

	configure_radio(spi_dev, &cfg);

	while (1) {
		// Put payload data here
		clear_payload_buffer();
		payload_buffer[0] = 0xAA;
		payload_buffer[1] = 0xBB;
		payload_buffer[2] = 0xCC;
		payload_buffer[3] = 0xDD;
		payload_buffer[4] = 0xEE;
		transmit_packet(spi_dev, &cfg, &payload_buffer, NETWORKID, TONODEID);
		printk("sent packet\n");
	}

}
```

## src/RFM69.c
```c
#include <device.h>
#include "cas_spi.h"
#include "rfm69.h"

void write_internal_reg(struct device *dev, struct spi_config *cfg, uint8_t reg_address, uint8_t value) {

	// Set MSB to 1, indicates a write
	reg_address |= 0x80;

	uint8_t send_buf[2] = { reg_address, value };
	int send_length = 2;
	uint8_t recieve_buf[2] = { 0x00, 0x00 };
	int recieve_length = 0;

	int status = cas_spi_transceive(dev, cfg, send_buf, send_length, recieve_buf, recieve_length);
	if (status != 0) printk("Error in rfm69.c: Failed to write internal register.\n");

	return;

}

uint8_t read_internal_reg(struct device *dev, struct spi_config *cfg, uint8_t reg_address) {

	// Set MSB to 0, indicates a read
	reg_address &= 0x7F;

	uint8_t send_buf[2] = { reg_address, 0x00 };
	int send_length = 2;
	uint8_t recieve_buf[2] = { 0x00, 0x00 };
	int recieve_length = 2;

	int status = cas_spi_transceive(dev, cfg, send_buf, send_length, recieve_buf, recieve_length);
	if (status != 0) printk("Error in rfm69.c: Failed to read internal register.\n");

	return recieve_buf[1];

}

void set_mode(struct device *dev, struct spi_config *cfg, uint8_t mode) {
	write_internal_reg(dev, cfg, REG_OPMODE, (RF_OPMODE_SEQUENCER_OFF | RF_OPMODE_LISTEN_OFF | mode));
}

void set_payload_length(struct device *dev, struct spi_config *cfg, uint8_t payload_length) {
	write_internal_reg(dev, cfg, REG_PAYLOADLENGTH, payload_length);
}

void set_frequency(struct device *dev, struct spi_config *cfg, uint8_t freq_msb, uint8_t freq_mid, uint8_t freq_lsb) {
	write_internal_reg(dev, cfg, REG_FRFMSB, freq_msb);
	write_internal_reg(dev, cfg, REG_FRFMID, freq_mid);
	write_internal_reg(dev, cfg, REG_FRFLSB, freq_lsb);
}

void configure_radio(struct device *dev, struct spi_config *cfg) {
	// Usually, the frequency should be either 433 MHz or 915 MHz
	set_frequency(dev, cfg, RF_FRFMSB_915, RF_FRFMID_915, RF_FRFLSB_915);
	set_payload_length(dev, cfg, PAYLOAD_LENGTH);
}

void transmit_packet(struct device *dev, struct spi_config *cfg, 
					 uint8_t *payload, uint8_t receiver_network, uint8_t receiver_address) {

	set_mode(dev, cfg, RF_OPMODE_STANDBY);

	// Assemble packet into the FIFO register
	for (int i=0; i<8; i++) { write_internal_reg(dev, cfg, REG_FIFO, PREAMBLE_BYTE); }
	write_internal_reg(dev, cfg, REG_FIFO, receiver_network);
	write_internal_reg(dev, cfg, REG_FIFO, receiver_address);
	for (int i=0; i<PAYLOAD_LENGTH; i++) { write_internal_reg(dev, cfg, REG_FIFO, payload[i]); }

	set_mode(dev, cfg, RF_OPMODE_TRANSMITTER);

	// Wait for confirmation that the packet was sent
	int timeout = 100000;
	uint8_t irq_flags = 0x00;
	while ((irq_flags & RF_IRQFLAGS2_PACKETSENT) == 0x00) {
		irq_flags = read_internal_reg(dev, cfg, REG_IRQFLAGS2);
		timeout--;
		if (timeout < 0) {
			printk("Error in rfm69.c: timeout occured when sending packet.\n");
			break;
		}
	}

	set_mode(dev, cfg, RF_OPMODE_STANDBY);

}
```

## src/RFM69.h
```c
#include <device.h>
#include "RFM69registers.h"

#ifndef RFM69_HEADER
#define RFM69_HEADER

/* The packet must be smaller than 66 bytes because the FIFO register
 * can hold at most 66 bytes. The structure of the packet is as follows:
 * 8 bytes: preamble (10101010)
 * 1 byte: network ID
 * 1 byte: destination address
 * 50 bytes: payload
 * See pages 51-52 of the datasheet for more information about packet structure. */
#define PAYLOAD_LENGTH 50
#define PACKET_LENGTH 60

// In binary: 10101010
#define PREAMBLE_BYTE 0xAA

void write_internal_reg(struct device *dev, struct spi_config *cfg, uint8_t reg_address, uint8_t value);

uint8_t read_internal_reg(struct device *dev, struct spi_config *cfg, uint8_t reg_address);

void set_mode(struct device *dev, struct spi_config *cfg, uint8_t mode);

void set_payload_length(struct device *dev, struct spi_config *cfg, uint8_t payload_length);

void set_frequency(struct device *dev, struct spi_config *cfg, uint8_t freq_msb, uint8_t freq_mid, uint8_t freq_lsb);

void configure_radio(struct device *dev, struct spi_config *cfg);

void transmit_packet(struct device *dev, struct spi_config *cfg, 
					 uint8_t *payload, uint8_t receiver_network, uint8_t receiver_address);

#endif
```

## src/cas_spi.c
```c
#include <device.h>
#include <drivers/spi.h>
#include <drivers/gpio.h>
#include "cas_spi.h"

uint8_t write_buf_contents[MAXIMUM_DATA_LENGTH];
uint8_t read_buf_contents[MAXIMUM_DATA_LENGTH];

struct spi_buf write_buf = {
	.buf = write_buf_contents,
	.len = 0,
};
struct spi_buf read_buf = {
	.buf = read_buf_contents,
	.len = 0,
};

struct spi_buf_set write_buf_set = {
	.buffers = &write_buf,
	.count = 1,
};
struct spi_buf_set read_buf_set = {
	.buffers = &read_buf,
	.count = 1,
};

struct spi_config* get_spi_config(struct device *gpio_device, int gpio_pin_num) {

	struct spi_cs_control ctrl = {
		.gpio_dev = gpio_device,
		.gpio_pin = gpio_pin_num,
		.gpio_dt_flags = GPIO_ACTIVE_LOW,
	};

	struct spi_config cfg = {
		.frequency = 1000000,
		.operation = SPI_OP_MODE_MASTER | SPI_WORD_SET(8) | SPI_TRANSFER_MSB | SPI_MODE_CPOL | SPI_MODE_CPHA,
		.slave = 0,
		.cs = &ctrl,
	};

	return &cfg;

}

void clear_write_buf_set() {
	for (int i=0; i<MAXIMUM_DATA_LENGTH; i++) { write_buf_contents[i] = 0x00; }
	write_buf.len = 0;
}
void clear_read_buf_set() {
	for (int i=0; i<MAXIMUM_DATA_LENGTH; i++) { read_buf_contents[i] = 0x00; }
	read_buf.len = 0;
}

int cas_spi_transceive(struct device *dev, struct spi_config *cfg, 
						uint8_t *send_buf, uint8_t send_length,
						uint8_t *receive_buf, uint8_t receive_length) {

	if (send_length > MAXIMUM_DATA_LENGTH || receive_length > MAXIMUM_DATA_LENGTH) {
		printk("Error in cas_spi.c: write or read length is too long.\n");
		return -1;
	}

	clear_write_buf_set();
	clear_read_buf_set();

	for (int i=0; i<send_length; i++) { write_buf_contents[i] = send_buf[i]; }
	write_buf.len = send_length;
	read_buf.len = receive_length;

	int status = spi_transceive(dev, cfg, &write_buf_set, &read_buf_set);
	if (status != 0) printk("Error in cas_spi.c: Failed to transceive over spi.\n");

	for (int i=0; i<receive_length; i++) { receive_buf[i] = read_buf_contents[i]; }

	return status;

}
```

## src/cas_spi.h
```c
#include <device.h>
#include <drivers/spi.h>
#include <drivers/gpio.h>

#ifndef CAS_SPI_HEADER
#define CAS_SPI_HEADER

/* Arbitrarily chosen for convenience purposes. This value can be increased if
 * desired, but be aware that the specific device you are communicating with
 * might have stricter limits on the amount of data it can recieve. */
#define MAXIMUM_DATA_LENGTH 64

void clear_write_buf_set();

void clear_read_buf_set();

int cas_spi_transceive(struct device *dev, struct spi_config *cfg, 
					   uint8_t *send_buf, uint8_t send_length,
					   uint8_t *receive_buf, uint8_t receive_length);

#endif
```

## src/spi.c
```c
#include <device.h>
#include <drivers/spi.h>
#include <drivers/gpio.h>

#define SPI_NODE cas_spi0

// The CS pin on the microcontroller for this SPI bus is GPIO pin B9
#define CS_PIN_BANK gpiob
#define CS_PIN_NUMBER 9

const struct spi_cs_control translator_spi_cs_control = {
    .gpio_dev = DEVICE_DT_GET(DT_NODELABEL(CS_PIN_BANK)),
    .gpio_pin = CS_PIN_NUMBER,
    .gpio_dt_flags = GPIO_ACTIVE_LOW,
    .delay = 10,
};

const struct spi_config translator_spi_config = {
    .operation = SPI_OP_MODE_MASTER,
    .cs = &translator_spi_cs_control,
};

uint8_t write_buf_contents [MAXIMUM_DATA_LENGTH];
uint8_t read_buf_contents [MAXIMUM_DATA_LENGTH];
uint8_t write_buf_length;
uint8_t read_buf_length;

struct spi_buf *write_buf;
struct spi_buf *read_buf;

struct spi_buf_set *write_buf_set;
struct spi_buf_set *read_buf_set;

struct device* get_spi_dev() {
	struct device *spi_dev = DEVICE_DT_GET(DT_NODELABEL(SPI_NODE));
	if (spi_dev == NULL) {
		printk("Error in spi.c: Failed to get device binding.\n");
		return NULL;
	}
	if (!device_is_ready(spi_dev)) {
		printk("Error in spi.c: Device is not ready.\n");
		return NULL;
	}
	return spi_dev;
}
```
