## CMakeLists.txt
```
# SPDX-License-Identifier: Apache-2.0

cmake_minimum_required(VERSION 3.20.0)

list(APPEND BOARD_ROOT ${CMAKE_CURRENT_SOURCE_DIR}/../../cas-zephyr-drivers/zephyr)
list(APPEND SOC_ROOT ${CMAKE_CURRENT_SOURCE_DIR}/../../cas-zephyr-drivers/zephyr)
list(APPEND DTS_ROOT ${CMAKE_CURRENT_SOURCE_DIR}/../../cas-zephyr-drivers/zephyr)

# To add out-of-tree device drivers to the project, uncomment the following line.
# list(APPEND ZEPHYR_EXTRA_MODULES ${CMAKE_CURRENT_SOURCE_DIR}/../../cas-zephyr-drivers/zephyr/drivers/my_driver)

find_package(Zephyr REQUIRED HINTS $ENV{ZEPHYR_BASE})

# Update the following line to contain the name of the current application.
project(bmp388-breakout)

target_sources(app PRIVATE src/main.c)
```

## prj.conf
```kconfig
CONFIG_SENSOR=y

CONFIG_I2C=y
CONFIG_SPI=n

CONFIG_BMP388=y
CONFIG_BMP388_TRIGGER_NONE=y

CONFIG_CBPRINTF_FP_SUPPORT=y
```

## src/main.c
```c
#include <zephyr.h>
#include <device.h>
#include <devicetree.h>
#include <drivers/sensor.h>

#define DEVICE_NODE bmp388_i2c_node

void main(void) {

	printk("BMP388 sensor application.\n");

	const struct device *dev = DEVICE_DT_GET(DT_NODELABEL(DEVICE_NODE));
	struct sensor_value pressure_value;
	struct sensor_value temperature_value;

	if (dev == NULL) {
		printk("Failed to get device binding.\n");
		return;
	}

	if (!device_is_ready(dev)) {
		printk("Device is not ready.\n");
		return;
	}

	while (1) {

		k_msleep(100);

		if (sensor_sample_fetch(dev) != 0) {
			printk("Sensor sample fetch fail.\n");
			continue;
		}

		if (sensor_channel_get(dev, SENSOR_CHAN_PRESS, &pressure_value) != 0) {
			printk("Sensor channel get fail.\n");
			continue;
		}

		if (sensor_channel_get(dev, SENSOR_CHAN_AMBIENT_TEMP, &temperature_value) != 0) {
			printk("Sensor channel get fail.\n");
			continue;
		}

		printk("Pressure:    %d kilopascal.\n", pressure_value.val1);
		printk("Temperature: %d degrees Celsius.\n", temperature_value.val1);

	}

}
```
